## conf/machine/lx2160ardb.conf
```bitbake
#@TYPE: Machine
#@NAME: NXP LX2160ARDB
#@SOC: LSCH3
#@DESCRIPTION: Machine configuration for running LX2160ARDB in 64-bit mode
#@MAINTAINER: Zongchun Yu <Zongchun.Yu@nxp.com>

require conf/machine/include/qoriq-arm64.inc
require conf/machine/include/arm/arch-arm64.inc

MACHINEOVERRIDES =. "fsl-lsch3:lx2160a:"

KERNEL_CLASSES  = " kernel-itbimage "
KERNEL_IMAGETYPES = "itbImage"

DTB_LOAD = "0x90000000"
UBOOT_ENTRYPOINT = "0x80080000"

UBOOT_CONFIG ??= "nor"
UBOOT_CONFIG[nor] = "lx2160ardb_defconfig,,u-boot-dtb.bin"

KERNEL_DEVICETREE ?= "freescale/fsl-lx2160a-rdb.dtb"
KERNEL_DEFCONFIG ?= "defconfig"

SERIAL_CONSOLES ?= "115200;ttyS0 115200;ttyS1 115200;ttyAMA0"
SERIAL_CONSOLES_CHECK ?= "${SERIAL_CONSOLES}"

EXTRA_IMAGEDEPENDS += "management-complex mc-utils"
USE_VT = "0"
```
